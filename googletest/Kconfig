## googletest/Kconfig
```kconfig
# SPDX-License-Identifier: Apache-2.0

config GOOGLETEST
	bool "GOOGLETEST Framework Support"
	help
	  This option enables GOOGLETEST framework
```

## modules/Kconfig
```kconfig
# SPDX-License-Identifier: Apache-2.0

menu "Modules"

rsource "calculator/Kconfig"
rsource "random_generator/Kconfig"

endmenu
```

## modules/random_generator/Kconfig
```kconfig
# SPDX-License-Identifier: Apache-2.0

config RANDOM_GENERATOR_MODULE
	bool "Random Generator Module Support"
	help
	  This option enables random generator module
```

## tests/googletest_sample/testcase.yaml
```yaml
common:
  tags: extensibility
  integration_platforms:
    - mps2/an385
tests:
  tests.googletest_sample: {}
```

## tests/unit_tests/calculator/testcase.yaml
```yaml
common:
  tags: extensibility
  integration_platforms:
    - mps2_an385
tests:
  CalculatorTest.AddTest:
    harness: gtest
  CalculatorTest.MultiplyTest:
    harness: gtest
```

## tests/unit_tests/random_generator/testcase.yaml
```yaml
common:
  tags: extensibility
  integration_platforms:
    - mps2/an385
tests:
  RandomGeneratorTest.MockRandomNumberGeneration:
    harness: gtest
  RandomGeneratorTest.DivideByRandomNumberFunction:
    harness: gtest
```

## west.yml
```yaml
# SPDX-License-Identifier: Apache-2.0

manifest:
  self:
    path: zephyr-gtest-app
    west-commands: scripts/west-commands.yml

  remotes:
    - name: zephyrproject-rtos
      url-base: https://github.com/zephyrproject-rtos
    - name: google
      url-base: https://github.com/google

  projects:
    - name: zephyr
      remote: zephyrproject-rtos
      revision: v4.0.0
      import:
        name-allowlist:
          - cmsis
          - segger
          - hal_nordic
    - name: googletest
      remote: google
      repo-path: googletest
      revision: e235eb34c6c4fed790ccdad4b16394301360dcd4
      path: zephyr-gtest-app/googletest/googletest
```
